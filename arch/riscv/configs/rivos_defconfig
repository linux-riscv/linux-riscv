## arch/riscv/crypto/Kconfig
```kconfig
# SPDX-License-Identifier: GPL-2.0

menu "Accelerated Cryptographic Algorithms for CPU (riscv)"

config CRYPTO_AES_RISCV64
	tristate "Ciphers: AES"
	depends on 64BIT && RISCV_ISA_V && TOOLCHAIN_HAS_VECTOR_CRYPTO
	select CRYPTO_ALGAPI
	select CRYPTO_LIB_AES
	help
	  Block ciphers: AES cipher algorithms (FIPS-197)

	  Architecture: riscv64 using:
	  - Zvkned vector crypto extension

config CRYPTO_AES_BLOCK_RISCV64
	tristate "Ciphers: AES, modes: ECB/CBC/CTR/XTS"
	depends on 64BIT && RISCV_ISA_V && TOOLCHAIN_HAS_VECTOR_CRYPTO
	select CRYPTO_AES_RISCV64
	select CRYPTO_SIMD
	select CRYPTO_SKCIPHER
	help
	  Length-preserving ciphers: AES cipher algorithms (FIPS-197)
	  with block cipher modes:
	  - ECB (Electronic Codebook) mode (NIST SP 800-38A)
	  - CBC (Cipher Block Chaining) mode (NIST SP 800-38A)
	  - CTR (Counter) mode (NIST SP 800-38A)
	  - XTS (XOR Encrypt XOR Tweakable Block Cipher with Ciphertext
	    Stealing) mode (NIST SP 800-38E and IEEE 1619)

	  Architecture: riscv64 using:
	  - Zvkned vector crypto extension
	  - Zvbb vector extension (XTS)
	  - Zvkb vector crypto extension (CTR/XTS)
	  - Zvkg vector crypto extension (XTS)

config CRYPTO_CHACHA_RISCV64
	tristate "Ciphers: ChaCha"
	depends on 64BIT && RISCV_ISA_V && TOOLCHAIN_HAS_VECTOR_CRYPTO
	select CRYPTO_SIMD
	select CRYPTO_SKCIPHER
	select CRYPTO_LIB_CHACHA_GENERIC
	help
	  Length-preserving ciphers: ChaCha20 stream cipher algorithm

	  Architecture: riscv64 using:
	  - Zvkb vector crypto extension

config CRYPTO_GHASH_RISCV64
	tristate "Hash functions: GHASH"
	depends on 64BIT && RISCV_ISA_V && TOOLCHAIN_HAS_VECTOR_CRYPTO
	select CRYPTO_GCM
	help
	  GCM GHASH function (NIST SP 800-38D)

	  Architecture: riscv64 using:
	  - Zvkg vector crypto extension

config CRYPTO_SHA256_RISCV64
	tristate "Hash functions: SHA-224 and SHA-256"
	depends on 64BIT && RISCV_ISA_V && TOOLCHAIN_HAS_VECTOR_CRYPTO
	select CRYPTO_SHA256
	help
	  SHA-224 and SHA-256 secure hash algorithm (FIPS 180)

	  Architecture: riscv64 using:
	  - Zvknha or Zvknhb vector crypto extensions
	  - Zvkb vector crypto extension

config CRYPTO_SHA512_RISCV64
	tristate "Hash functions: SHA-384 and SHA-512"
	depends on 64BIT && RISCV_ISA_V && TOOLCHAIN_HAS_VECTOR_CRYPTO
	select CRYPTO_SHA512
	help
	  SHA-384 and SHA-512 secure hash algorithm (FIPS 180)

	  Architecture: riscv64 using:
	  - Zvknhb vector crypto extension
	  - Zvkb vector crypto extension

config CRYPTO_SM3_RISCV64
	tristate "Hash functions: SM3 (ShangMi 3)"
	depends on 64BIT && RISCV_ISA_V && TOOLCHAIN_HAS_VECTOR_CRYPTO
	select CRYPTO_HASH
	select CRYPTO_SM3
	help
	  SM3 (ShangMi 3) secure hash function (OSCCA GM/T 0004-2012)

	  Architecture: riscv64 using:
	  - Zvksh vector crypto extension
	  - Zvkb vector crypto extension

config CRYPTO_SM4_RISCV64
	tristate "Ciphers: SM4 (ShangMi 4)"
	depends on 64BIT && RISCV_ISA_V && TOOLCHAIN_HAS_VECTOR_CRYPTO
	select CRYPTO_ALGAPI
	select CRYPTO_SM4
	help
	  SM4 cipher algorithms (OSCCA GB/T 32907-2016,
	  ISO/IEC 18033-3:2010/Amd 1:2021)

	  SM4 (GBT.32907-2016) is a cryptographic standard issued by the
	  Organization of State Commercial Administration of China (OSCCA)
	  as an authorized cryptographic algorithms for the use within China.

	  Architecture: riscv64 using:
	  - Zvksed vector crypto extension
	  - Zvkb vector crypto extension

endmenu
```

## arch/riscv/kernel/tests/Kconfig.debug
```kconfig
# SPDX-License-Identifier: GPL-2.0-only
menu "arch/riscv/kernel Testing and Coverage"

menuconfig RUNTIME_KERNEL_TESTING_MENU
       bool "arch/riscv/kernel runtime Testing"
       def_bool y
       help
         Enable riscv kernel runtime testing.

if RUNTIME_KERNEL_TESTING_MENU

config RISCV_MODULE_LINKING_KUNIT
       bool "KUnit test riscv module linking at runtime" if !KUNIT_ALL_TESTS
       depends on KUNIT
       default KUNIT_ALL_TESTS
       help
         Enable this option to test riscv module linking at boot. This will
	 enable a module called "test_module_linking".

         KUnit tests run during boot and output the results to the debug log
         in TAP format (http://testanything.org/). Only useful for kernel devs
         running the KUnit test harness, and not intended for inclusion into a
         production build.

         For more information on KUnit and unit tests in general please refer
         to the KUnit documentation in Documentation/dev-tools/kunit/.

         If unsure, say N.

endif # RUNTIME_TESTING_MENU

endmenu # "arch/riscv/kernel runtime Testing"
```

## arch/riscv/lib/Kconfig.debug
```kconfig
# SPDX-License-Identifier: GPL-2.0-only
menu "riscv lib Testing and Coverage"

menuconfig RUNTIME_LIB_TESTING_MENU
	bool "Runtime Lib Testing"
	def_bool y
	help
	  Enable riscv runtime lib testing.

if RUNTIME_LIB_TESTING_MENU

config RISCV_CHECKSUM_KUNIT
	tristate "KUnit test riscv checksum functions at runtime" if !KUNIT_ALL_TESTS
	depends on KUNIT
	default KUNIT_ALL_TESTS
	help
	  Enable this option to test the checksum functions at boot.

	  KUnit tests run during boot and output the results to the debug log
	  in TAP format (http://testanything.org/). Only useful for kernel devs
	  running the KUnit test harness, and not intended for inclusion into a
	  production build.

	  For more information on KUnit and unit tests in general please refer
	  to the KUnit documentation in Documentation/dev-tools/kunit/.

	  If unsure, say N.

endif # RUNTIME_LIB_TESTING_MENU

endmenu # "riscv lib Testing and Coverage"
```

## drivers/cache/Kconfig
```kconfig
# SPDX-License-Identifier: GPL-2.0
menu "Cache Drivers"

config AX45MP_L2_CACHE
	bool "Andes Technology AX45MP L2 Cache controller"
	depends on RISCV
	select RISCV_NONSTANDARD_CACHE_OPS
	help
	  Support for the L2 cache controller on Andes Technology AX45MP platforms.

config SIFIVE_CCACHE
	bool "Sifive Composable Cache controller"
	depends on ARCH_SIFIVE || ARCH_STARFIVE
	help
	  Support for the composable cache controller on SiFive platforms.

config STARLINK_500_CACHE
	bool "StarLink-500 Cache controller"
	depends on RISCV_DMA_NONCOHERENT
	depends on ERRATA_STARFIVE
	select RISCV_NONSTANDARD_CACHE_OPS
	default y
	help
	  Support for the StarLink-500 cache controller on StarFive platforms.

endmenu
```

## drivers/clk/sophgo/Kconfig
```kconfig
# SPDX-License-Identifier: GPL-2.0
# common clock support for SOPHGO SoC family.

config CLK_SOPHGO_SG2042
	bool "Sophgo SG2042 clock support"
	depends on ARCH_SOPHGO || COMPILE_TEST
	help
	  Say yes here to support the clock controller on the Sophgo SG2042 SoC.
```

## drivers/gpu/drm/rivos/Kconfig
```kconfig
# SPDX-License-Identifier: GPL-2.0-only

# depend on PCI
# MMU_NOTIFIER
# HMM_MIRROR probably
# DRM_TTM ?
# DRM_TTM_HELPER ?
# FW_LOADER ?

config RIVOS_DPA
	bool "Support for Rivos DPA device"
	default y
	depends on DRM=y
	depends on PCI && MMU && RISCV
	select DRM_BUDDY
	select DRM_TTM_HELPER
	select DRM_TTM
	help
	 This is a Rivos DPA device driver.
```

## drivers/iommu/riscv/Kconfig
```kconfig
# SPDX-License-Identifier: GPL-2.0-only
# RISC-V IOMMU support

config RISCV_IOMMU
	bool "RISC-V IOMMU driver"
	depends on RISCV
	select IOMMU_API
	select IOMMU_DMA
	select IOMMU_IO_PGTABLE
	select IOMMU_IOVA
	select IOMMU_SVA
	select IOASID
	select PCI_MSI
	select PCI_ATS
	select PCI_PRI
	select PCI_PASID
	select MMU_NOTIFIER
	help
	  This option enables support for the RISC-V IOMMU hardware.

if RISCV_IOMMU

config RISCV_IOMMU_DEBUGFS
	bool "Export RISC-V IOMMU internals in Debugfs"
	depends on IOMMU_DEBUGFS
	help
	  !!!WARNING!!!

	  DO NOT ENABLE THIS OPTION UNLESS YOU REALLY KNOW WHAT YOU ARE DOING!!!

	  Expose RISC-V IOMMU internals in Debugfs.

	  This option is -NOT- intended for production environments, and should
	  only be enabled for debugging RISC-V IOMMU.

endif # RISCV_IOMMU
```

## drivers/phy/sophgo/Kconfig
```kconfig
# SPDX-License-Identifier: GPL-2.0-only

config PHY_SOPHGO_CV1800_USB
	tristate "SOPHGO CV1800 USB 2.0 PHY driver"
	depends on OF && (ARCH_SOPHGO || COMPILE_TEST)
	select GENERIC_PHY
	help
	  Enable this to support the USB 2.0 PHY on Sophgo CV1800
	  and SG200x SoCs.
	  If unsure, say N.
```

## drivers/platform/rivos/Kconfig
```kconfig
#
# Rivos Platform Specific Drivers
#

menuconfig RIVOS_PLATFORM_DEVICES
	bool "Rivos Platform Specific Device Drivers"
	help
	  Say Y here to get to see options for device drivers of various
	  Rivos platforms, including vendor-specific processor extension
	  and hardware monitor drivers. This option itself does not add
	  any kernel code.

	  If you say N, all options in this submenu will be skipped and disabled.

if RIVOS_PLATFORM_DEVICES

config RIVOS_PWC
	tristate "Rivos PWC hwmon driver support"
	depends on HWMON
	depends on PCI
	select AUXILIARY_BUS
	default y
	help
	  Rivos PWC driver that exposes hwmon sensors for thermal and power
	  monitoring. Enabling this will build the PWC PCI driver and all sub
	  drivers that can handle DVSEC functions exposed by the PWC PCI device.

endif # RIVOS_PLATFORM_DEVICES
```

## drivers/reset/sophgo/Kconfig
```kconfig
# SPDX-License-Identifier: GPL-2.0-only

config RESET_SOPHGO_SG2042
	bool "Sophgo SG2042 Reset Driver"
	depends on ARCH_SOPHGO || COMPILE_TEST
	select RESET_SIMPLE
	default ARCH_SOPHGO
	help
	  This enables the reset controller driver for the Sophgo SG2042 SoC.
```

## drivers/rivos/Kconfig
```kconfig
config RIVOS_DCE
	tristate "Rivos DCE device"
	default y
	help
	  Rivos DCE device
```

## Documentation/devicetree/bindings/thermal/sophgo,cv180x-thermal.yaml
```yaml
# SPDX-License-Identifier: (GPL-2.0 OR BSD-2-Clause)
%YAML 1.2
---
$id: http://devicetree.org/schemas/thermal/sophgo,cv180x-thermal.yaml#
$schema: http://devicetree.org/meta-schemas/core.yaml#

title: Sophgo CV180x on-SoC Thermal Sensor

maintainers:
  - Haylen Chu <heylenay@outlook.com>

description: Binding for Sophgo CV180x on-SoC thermal sensor

properties:
  compatible:
    enum:
      - sophgo,cv1800-thermal
      - sophgo,cv180x-thermal

  reg:
    maxItems: 1

  clocks:
    description: The thermal sensor clock

  clock-names:
    const: clk_tempsen

  accumulation-period:
    $ref: /schemas/types.yaml#/definitions/uint32
    description: Accumulation period for a sample
    oneOf:
      - const: 0
        description: 512 ticks
      - const: 1
        description: 1024 ticks
      - const: 2
        description: 2048 ticks
      - const: 3
        description: 4096 ticks
    default: 2

  chop-period:
    $ref: /schemas/types.yaml#/definitions/uint32
    description: ADC chop period
    oneOf:
      - const: 0
        description: 128 ticks
      - const: 1
        description: 256 ticks
      - const: 2
        description: 512 ticks
      - const: 3
        description: 1024 ticks
    default: 3

  sample-cycle-us:
    description: Period between samples
    default: 1000000

  '#thermal-sensor-cells':
    const: 0

required:
  - compatible
  - reg
  - clocks
  - clock-names

additionalProperties: false

examples:
  - |
        #include <dt-bindings/clock/sophgo,cv1800.h>
        thermal-sensor@30e0000 {
            compatible = "sophgo,cv180x-thermal";
            reg = <0x30e0000 0x100>;
            clocks = <&clk CLK_TEMPSEN>;
            clock-names = "clk_tempsen";
            #thermal-sensor-cells = <0>;
        };
...
```

## arch/riscv/configs/nommu_sim_defconfig
```kconfig
CONFIG_LOG_BUF_SHIFT=16
CONFIG_PRINTK_SAFE_LOG_BUF_SHIFT=12
CONFIG_BLK_DEV_INITRD=y
CONFIG_INITRAMFS_SOURCE="rootfs.cpio"
# CONFIG_RD_BZIP2 is not set
# CONFIG_RD_LZMA is not set
# CONFIG_RD_XZ is not set
# CONFIG_RD_LZO is not set
# CONFIG_RD_LZ4 is not set
# CONFIG_RD_ZSTD is not set
CONFIG_INITRAMFS_COMPRESSION_NONE=y
CONFIG_CC_OPTIMIZE_FOR_SIZE=y
CONFIG_EXPERT=y
# CONFIG_SYSFS_SYSCALL is not set
# CONFIG_FHANDLE is not set
# CONFIG_BASE_FULL is not set
# CONFIG_EPOLL is not set
# CONFIG_SIGNALFD is not set
# CONFIG_TIMERFD is not set
# CONFIG_EVENTFD is not set
# CONFIG_AIO is not set
# CONFIG_IO_URING is not set
# CONFIG_ADVISE_SYSCALLS is not set
# CONFIG_KALLSYMS is not set
# CONFIG_MMU is not set
CONFIG_SOC_RIVOS_SIM_TINY=y
CONFIG_NONPORTABLE=y
CONFIG_RISCV_TIMER_DIV=100
CONFIG_CMDLINE="console=hvc0 earlycon=ot,mmio32,0x11000000 init=/bin/sh"
CONFIG_CMDLINE_FORCE=y
CONFIG_BUILTIN_DTB=y
CONFIG_JUMP_LABEL=y
CONFIG_PARTITION_ADVANCED=y
# CONFIG_MSDOS_PARTITION is not set
# CONFIG_EFI_PARTITION is not set
# CONFIG_MQ_IOSCHED_DEADLINE is not set
# CONFIG_MQ_IOSCHED_KYBER is not set
CONFIG_BINFMT_FLAT=y
# CONFIG_COREDUMP is not set
CONFIG_SLOB=y
# CONFIG_COMPAT_BRK is not set
# CONFIG_VM_EVENT_COUNTERS is not set
CONFIG_DEVTMPFS=y
CONFIG_DEVTMPFS_MOUNT=y
# CONFIG_FW_LOADER is not set
# CONFIG_ALLOW_DEV_COREDUMP is not set
# CONFIG_INPUT_KEYBOARD is not set
# CONFIG_INPUT_MOUSE is not set
# CONFIG_SERIO is not set
# CONFIG_LEGACY_PTYS is not set
# CONFIG_LDISC_AUTOLOAD is not set
CONFIG_SERIAL_8250=y
# CONFIG_SERIAL_8250_DEPRECATED_OPTIONS is not set
CONFIG_SERIAL_8250_CONSOLE=y
CONFIG_HVC_OT=y
# CONFIG_HW_RANDOM is not set
# CONFIG_DEVMEM is not set
# CONFIG_HWMON is not set
# CONFIG_VGA_CONSOLE is not set
# CONFIG_HID is not set
# CONFIG_USB_SUPPORT is not set
CONFIG_EXT2_FS=y
# CONFIG_DNOTIFY is not set
# CONFIG_INOTIFY_USER is not set
# CONFIG_MISC_FILESYSTEMS is not set
CONFIG_LSM="[]"
CONFIG_PRINTK_TIME=y
# CONFIG_SCHED_DEBUG is not set
# CONFIG_FTRACE is not set
# CONFIG_RUNTIME_TESTING_MENU is not set
```

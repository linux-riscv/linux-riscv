## Documentation/devicetree/bindings/interrupt-controller/riscv,aplic.yaml
```yaml
# SPDX-License-Identifier: (GPL-2.0-only OR BSD-2-Clause)
%YAML 1.2
---
$id: http://devicetree.org/schemas/interrupt-controller/riscv,aplic.yaml#
$schema: http://devicetree.org/meta-schemas/core.yaml#

title: RISC-V Advancded Platform Level Interrupt Controller (APLIC)

maintainers:
  - Anup Patel <anup@brainfault.org>

description:
  The RISC-V advanced interrupt architecture (AIA) defines advanced platform
  level interrupt controller (APLIC) for handling wired interrupts in a
  RISC-V platform. The RISC-V AIA specification can be found at
  https://github.com/riscv/riscv-aia.

  The RISC-V APLIC is implemented as hierarchical APLIC domains where all
  interrupt sources connect to the root domain which can further delegate
  interrupts to child domains. We have one device tree node for each APLIC
  domain.

allOf:
  - $ref: /schemas/interrupt-controller.yaml#

properties:
  compatible:
    items:
      - enum:
          - vendor,chip-aplic
      - const: riscv,aplic

  reg:
    maxItems: 1

  interrupt-controller: true

  "#interrupt-cells":
    const: 2

  interrupts-extended:
    minItems: 1
    maxItems: 16384
    description:
      The presence of this property implies that given APLIC domain directly
      injects external interrupts to a set of RISC-V HARTS (or CPUs). Each
      node pointed to should be a riscv,cpu-intc node, which has a riscv node
      (i.e. RISC-V HART) as parent.

  msi-parent:
    description:
      The presence of this property implies that given APLIC domain forwards
      wired interrupts as MSIs to a AIA incoming message signaled interrupt
      controller (IMSIC). This property should be considered only when the
      interrupts-extended property is absent.

  riscv,num-sources:
    $ref: "/schemas/types.yaml#/definitions/uint32"
    minimum: 1
    maximum: 1023
    description:
      Specifies how many wired interrupts are supported by this APLIC domain.

  riscv,children:
    $ref: '/schemas/types.yaml#/definitions/phandle-array'
    minItems: 1
    maxItems: 1024
    description:
      This property represents a list of child APLIC domains for the given
      APLIC domain. Each child APLIC domain is assigned child index in
      increasing order with the first child APLIC domain assigned child
      index 0. The APLIC domain child index is used by firmware to delegate
      interrupts from the given APLIC domain to a particular child APLIC
      domain.

  riscv,delegate:
    $ref: '/schemas/types.yaml#/definitions/phandle-array'
    minItems: 1
    maxItems: 1024
    description:
      This property represents a interrupt delegation list where each entry
      is a triple consisting of child APLIC domain phandle, first interrupt
      number, and last interrupt number. The firmware will configure interrupt
      delegation registers based on interrupt delegation list.

additionalProperties: false

required:
  - compatible
  - reg
  - interrupt-controller
  - "#interrupt-cells"
  - riscv,num-sources

examples:
  - |
    // Example 1 (APIC domain directly injecting interrupt to HARTs):

    aplic0: interrupt-controller@c000000 {
      compatible = "vendor,chip-aplic", "riscv,aplic";
      interrupts-extended = <&cpu1_intc 11>,
                            <&cpu2_intc 11>,
                            <&cpu3_intc 11>,
                            <&cpu4_intc 11>;
      reg = <0xc000000 0x4080>;
      interrupt-controller;
      #interrupt-cells = <2>;
      riscv,num-sources = <63>;
      riscv,children = <&aplic1>;
      riscv,delegate = <&aplic1 1 63>;
    };

    aplic1: interrupt-controller@d000000 {
      compatible = "vendor,chip-aplic", "riscv,aplic";
      interrupts-extended = <&cpu1_intc 9>,
                            <&cpu2_intc 9>,
                            <&cpu3_intc 9>,
                            <&cpu4_intc 9>;
      reg = <0xd000000 0x4080>;
      interrupt-controller;
      #interrupt-cells = <2>;
      riscv,num-sources = <63>;
    };

  - |
    // Example 2 (APIC domain forwarding interrupts as MSIs):

    interrupt-controller@d000000 {
      compatible = "vendor,chip-aplic", "riscv,aplic";
      msi-parent = <&imsics>;
      reg = <0xd000000 0x4000>;
      interrupt-controller;
      #interrupt-cells = <2>;
      riscv,num-sources = <63>;
    };
...
```

## Documentation/devicetree/bindings/interrupt-controller/riscv,imsic.yaml
```yaml
# SPDX-License-Identifier: (GPL-2.0-only OR BSD-2-Clause)
%YAML 1.2
---
$id: http://devicetree.org/schemas/interrupt-controller/riscv,imsic.yaml#
$schema: http://devicetree.org/meta-schemas/core.yaml#

title: RISC-V Incoming MSI Controller (IMSIC)

maintainers:
  - Anup Patel <anup@brainfault.org>

description:
  The RISC-V advanced interrupt architecture (AIA) defines a per-CPU incoming
  MSI controller (IMSIC) for handling MSIs in a RISC-V platform. The RISC-V
  AIA specification can be found at https://github.com/riscv/riscv-aia.

  The IMSIC is a per-CPU (or per-HART) device with separate interrupt file
  for each privilege level (machine or supervisor). The configuration of
  a IMSIC interrupt file is done using AIA CSRs and it also has a 4KB MMIO
  space to receive MSIs from devices. Each IMSIC interrupt file supports a
  fixed number of interrupt identities (to distinguish MSIs from devices)
  which is same for given privilege level across CPUs (or HARTs).

  The arrangement of IMSIC interrupt files in MMIO space of a RISC-V platform
  follows a particular scheme defined by the RISC-V AIA specification. A IMSIC
  group is a set of IMSIC interrupt files co-located in MMIO space and we can
  have multiple IMSIC groups (i.e. clusters, sockets, chiplets, etc) in a
  RISC-V platform. The MSI target address of a IMSIC interrupt file at given
  privilege level (machine or supervisor) encodes group index, HART index,
  and guest index (shown below).

  XLEN-1           >=24                                 12    0
  |                  |                                  |     |
  -------------------------------------------------------------
  |xxxxxx|Group Index|xxxxxxxxxxx|HART Index|Guest Index|  0  |
  -------------------------------------------------------------

  The device tree of a RISC-V platform will have one IMSIC device tree node
  for each privilege level (machine or supervisor) which collectively describe
  IMSIC interrupt files at that privilege level across CPUs (or HARTs).

allOf:
  - $ref: /schemas/interrupt-controller.yaml#

properties:
  compatible:
    items:
      - enum:
          - vendor,chip-imsics
      - const: riscv,imsics

  reg:
    minItems: 1
    maxItems: 128
    description:
      Base address of each IMSIC group.

  interrupt-controller: true

  "#interrupt-cells":
    const: 0

  msi-controller: true

  interrupts-extended:
    minItems: 1
    maxItems: 32768
    description:
      This property represents the set of CPUs (or HARTs) for which given
      device tree node describes the IMSIC interrupt files. Each node pointed
      to should be a riscv,cpu-intc node, which has a riscv node (i.e. RISC-V
      HART) as parent.

  riscv,num-ids:
    $ref: /schemas/types.yaml#/definitions/uint32
    minimum: 63
    maximum: 2047
    description:
      Specifies how many interrupt identities are supported by IMSIC interrupt
      file.

  riscv,num-guest-ids:
    $ref: /schemas/types.yaml#/definitions/uint32
    minimum: 63
    maximum: 2047
    description:
      Specifies how many interrupt identities are supported by IMSIC guest
      interrupt file. When not specified the number of interrupt identities
      supported by IMSIC guest file is assumed to be same as specified by
      the riscv,num-ids property.

  riscv,slow-ipi:
    type: boolean
    description:
      The presence of this property implies that software interrupts (i.e.
      IPIs) using IMSIC software injected MSIs is slower compared to other
      software interrupt mechanisms (such as SBI IPI) on the underlying
      RISC-V platform.

  riscv,guest-index-bits:
    minimum: 0
    maximum: 7
    description:
      Specifies number of guest index bits in the MSI target address. When
      not specified it is assumed to be 0.

  riscv,hart-index-bits:
    minimum: 0
    maximum: 15
    description:
      Specifies number of HART index bits in the MSI target address. When
      not specified it is estimated based on the interrupts-extended property.

  riscv,group-index-bits:
    minimum: 0
    maximum: 7
    description:
      Specifies number of group index bits in the MSI target address. When
      not specified it is assumed to be 0.

  riscv,group-index-shift:
    $ref: /schemas/types.yaml#/definitions/uint32
    minimum: 24
    maximum: 55
    description:
      Specifies the least significant bit of the group index bits in the
      MSI target address. When not specified it is assumed to be 24.

additionalProperties: false

required:
  - compatible
  - reg
  - interrupt-controller
  - msi-controller
  - interrupts-extended
  - riscv,num-ids

examples:
  - |
    // Example 1 (Machine-level IMSIC files with just one group):

    imsic_mlevel: interrupt-controller@24000000 {
      compatible = "vendor,chip-imsics", "riscv,imsics";
      interrupts-extended = <&cpu1_intc 11>,
                            <&cpu2_intc 11>,
                            <&cpu3_intc 11>,
                            <&cpu4_intc 11>;
      reg = <0x28000000 0x4000>;
      interrupt-controller;
      #interrupt-cells = <0>;
      msi-controller;
      riscv,num-ids = <127>;
    };

  - |
    // Example 2 (Supervisor-level IMSIC files with two groups):

    imsic_slevel: interrupt-controller@28000000 {
      compatible = "vendor,chip-imsics", "riscv,imsics";
      interrupts-extended = <&cpu1_intc 9>,
                            <&cpu2_intc 9>,
                            <&cpu3_intc 9>,
                            <&cpu4_intc 9>;
      reg = <0x28000000 0x2000>, /* Group0 IMSICs */
            <0x29000000 0x2000>; /* Group1 IMSICs */
      interrupt-controller;
      #interrupt-cells = <0>;
      msi-controller;
      riscv,num-ids = <127>;
      riscv,group-index-bits = <1>;
      riscv,group-index-shift = <24>;
    };
...
```

## Documentation/devicetree/bindings/mailbox/sophgo,cv1800-mailbox.yaml
```yaml
# SPDX-License-Identifier: (GPL-2.0 OR BSD-2-Clause)
%YAML 1.2
---
$id: http://devicetree.org/schemas/mailbox/sophgo,cv1800-mailbox.yaml#
$schema: http://devicetree.org/meta-schemas/core.yaml#

title: Sophgo cv1800 mailbox controller

maintainers:
  - Yuntao Dai <d1581209858@live.com>

description:
  The Sophgo cv18x SoCs mailbox has 8 channels and 8 bytes per channel for
  different processors. Any processer can write data in a channel, and
  set co-responding register to raise interrupt to notice another processor,
  and it is allowed to send data to itself.
  Sophgo cv18x SoCs has 3 processors and numbered as
  <1> C906L
  <2> C906B
  <3> 8051

properties:
  compatible:
    enum:
      - sophgo,cv1800-mailbox

  reg:
    maxItems: 1

  interrupts:
    maxItems: 1

  interrupt-names:
    const: mailbox

  "#mbox-cells":
    const: 2
    description:
      The first cell indicates which channel is used, the second cell indicates
      sending to which processor

required:
  - compatible
  - reg
  - interrupts
  - "#mbox-cells"

additionalProperties: false

examples:
  - |
    #include <dt-bindings/interrupt-controller/irq.h>

    mailbox: mailbox@1900000 {
        compatible = "sophgo,cv1800-mailbox";
        reg = <0x01900000 0x1000>;
        interrupts = <101 IRQ_TYPE_LEVEL_HIGH>;
        interrupt-names = "mailbox";
        interrupt-parent = <&plic>;
        #mbox-cells = <2>;
    };
```

## Documentation/devicetree/bindings/mailbox/thead,th1520-mbox.yaml
```yaml
# SPDX-License-Identifier: (GPL-2.0-only OR BSD-2-Clause)
%YAML 1.2
---
$id: http://devicetree.org/schemas/mailbox/thead,th1520-mbox.yaml#
$schema: http://devicetree.org/meta-schemas/core.yaml#

title: T-head TH1520 Mailbox Controller

description:
  The T-head mailbox controller enables communication and coordination between
  cores within the SoC by passing messages (e.g., data, status, and control)
  through mailbox channels. It also allows one core to signal another processor
  using interrupts via the Interrupt Controller Unit (ICU).

maintainers:
  - Michal Wilczynski <m.wilczynski@samsung.com>

properties:
  compatible:
    const: thead,th1520-mbox

  reg:
    items:
      - description: Mailbox local base address
      - description: Remote ICU 0 base address
      - description: Remote ICU 1 base address
      - description: Remote ICU 2 base address

  reg-names:
    items:
      - const: local
      - const: remote-icu0
      - const: remote-icu1
      - const: remote-icu2

  interrupts:
    maxItems: 1

  '#mbox-cells':
    const: 2
    description: |
      Specifies the number of cells needed to encode the mailbox specifier.
      The mailbox specifier consists of two cells:
        - Destination CPU ID.
        - Type, which can be one of the following:
            - 0:
                - TX & RX channels share the same channel.
                - Equipped with 7 info registers to facilitate data sharing.
                - Supports IRQ for signaling.
            - 1:
                - TX & RX operate as doorbell channels.
                - Does not have dedicated info registers.
                - Lacks ACK support.

required:
  - compatible
  - reg
  - reg-names
  - interrupts
  - '#mbox-cells'

additionalProperties: false

examples:
  - |

    soc {
      #address-cells = <2>;
      #size-cells = <2>;
      mailbox@ffffc38000 {
        compatible = "thead,th1520-mbox";
        reg = <0xff 0xffc38000 0x0 0x4000>,
              <0xff 0xffc44000 0x0 0x1000>,
              <0xff 0xffc4c000 0x0 0x1000>,
              <0xff 0xffc54000 0x0 0x1000>;
        reg-names = "local", "remote-icu0", "remote-icu1", "remote-icu2";
        interrupts = <28>;
        #mbox-cells = <2>;
      };
    };
```

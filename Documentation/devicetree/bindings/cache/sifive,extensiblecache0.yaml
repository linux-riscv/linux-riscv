## Documentation/devicetree/bindings/cache/sifive,extensiblecache0.yaml
```yaml
# SPDX-License-Identifier: (GPL-2.0 OR BSD-2-Clause)
# Copyright (C) 2023-2024 SiFive, Inc.
%YAML 1.2
---
$id: http://devicetree.org/schemas/cache/sifive,extensiblecache0.yaml#
$schema: http://devicetree.org/meta-schemas/core.yaml#

title: SiFive Extensible Cache Controller

maintainers:
  - Eric Lin <eric.lin@sifive.com>

description:
  The SiFive Extensible Cache Controller provides a high-performance extensible
  system (L2 or L3) cache. It is divided into several independent heterogeneous
  slices, enabling a flexible topology and physical design.

allOf:
  - $ref: /schemas/cache-controller.yaml#

select:
  properties:
    compatible:
      contains:
        enum:
          - sifive,extensiblecache0

  required:
    - compatible

properties:
  compatible:
    items:
      - const: sifive,extensiblecache0
      - const: cache

  "#address-cells": true
  "#size-cells": true
  ranges: true

  interrupts:
    maxItems: 1

  cache-block-size:
    const: 64

  cache-level: true
  cache-sets: true
  cache-size: true
  cache-unified: true

patternProperties:
  "^cache-controller@[0-9a-f]+$":
    type: object
    additionalProperties: false
    properties:
      reg:
        maxItems: 1

      cache-block-size:
        const: 64

      cache-sets: true
      cache-size: true
      cache-unified: true

      sifive,bm-event-counters:
        $ref: /schemas/types.yaml#/definitions/uint32
        default: 0
        description: Number of bucket monitor registers in this slice

      sifive,cache-ways:
        $ref: /schemas/types.yaml#/definitions/uint32
        description: Number of ways in this slice (independent of cache size)

      sifive,perfmon-counters:
        $ref: /schemas/types.yaml#/definitions/uint32
        default: 0
        description: Number of PMU counter registers in this slice

    required:
      - reg
      - cache-block-size
      - cache-sets
      - cache-size
      - cache-unified
      - sifive,cache-ways

required:
  - compatible
  - ranges
  - interrupts
  - cache-block-size
  - cache-level
  - cache-sets
  - cache-size
  - cache-unified

additionalProperties: false

examples:
  - |
    cache-controller@30040000 {
        compatible = "sifive,extensiblecache0", "cache";
        ranges = <0x30040000 0x30040000 0x10000>;
        interrupts = <0x4>;
        cache-block-size = <0x40>;
        cache-level = <3>;
        cache-sets = <0x800>;
        cache-size = <0x100000>;
        cache-unified;
        #address-cells = <1>;
        #size-cells = <1>;

        cache-controller@30040000 {
            reg = <0x30040000 0x4000>;
            cache-block-size = <0x40>;
            cache-sets = <0x400>;
            cache-size = <0x80000>;
            cache-unified;
            sifive,bm-event-counters = <8>;
            sifive,cache-ways = <9>;
            sifive,perfmon-counters = <8>;
        };

        cache-controller@30044000 {
            reg = <0x30044000 0x4000>;
            cache-block-size = <0x40>;
            cache-sets = <0x400>;
            cache-size = <0x80000>;
            cache-unified;
            sifive,bm-event-counters = <8>;
            sifive,cache-ways = <9>;
            sifive,perfmon-counters = <8>;
        };
    };
```

## Documentation/devicetree/bindings/cache/starfive,starlink-500-cache.yaml
```yaml
# SPDX-License-Identifier: (GPL-2.0 OR BSD-2-Clause)
%YAML 1.2
---
$id: http://devicetree.org/schemas/cache/starfive,starlink-500-cache.yaml#
$schema: http://devicetree.org/meta-schemas/core.yaml#

title: StarFive StarLink-500 Cache Controller

maintainers:
  - Joshua Yeong <joshua.yeong@starfivetech.com>

description:
  StarFive's StarLink-500 controller manages cache shared between clusters of
  CPU cores. The cache driver provides mechanism to perform invalidate and write
  back functionality to the shared memory.

allOf:
  - $ref: /schemas/cache-controller.yaml#

# We need a select here so we don't match all nodes with 'cache'
select:
  properties:
    compatible:
      contains:
        enum:
          - starfive,starlink-500-cache

  required:
    - compatible

properties:
  compatible:
    items:
      - const: starfive,starlink-500-cache
      - const: cache

  reg:
    maxItems: 1

  cache-size: true
  cache-sets: true
  cache-block-size: true
  cache-level: true
  cache-unified: true

additionalProperties: false

required:
  - compatible
  - reg

examples:
  - |
      cache-controller@15000000 {
        compatible = "starfive,starlink-500-cache", "cache";
        reg = <0x15000000 0x278>;
        cache-block-size = <64>;
        cache-level = <3>;
        cache-sets = <8192>;
        cache-size = <0x400000>;
        cache-unified;
      };
```

## Documentation/devicetree/bindings/clock/sophgo,sg2042-clkgen.yaml
```yaml
# SPDX-License-Identifier: (GPL-2.0 OR BSD-2-Clause)
%YAML 1.2
---
$id: http://devicetree.org/schemas/clock/sophgo,sg2042-clkgen.yaml#
$schema: http://devicetree.org/meta-schemas/core.yaml#

title: Sophgo SG2042 Clock Generator

description:
  These clocks have configuration registers in the CLOCK range of memory-map.

maintainers:
  - Chen Wang <unicorn_wang@outlook.com>

properties:
  compatible:
    const: sophgo,sg2042-clkgen

  reg:
    maxItems: 1

  '#clock-cells':
    const: 1
    description:
      See <dt-bindings/clock/sophgo,sg2042-clkgen.h> for valid indices.

required:
  - compatible
  - reg
  - '#clock-cells'

additionalProperties: false

examples:
  - |
    clock-controller@30012000 {
        compatible = "sophgo,sg2042-clkgen";
        reg = <0x30012000 0x1000>;
        #clock-cells = <1>;
    };
```

## Documentation/devicetree/bindings/clock/sophgo,sg2042-sysclk.yaml
```yaml
# SPDX-License-Identifier: (GPL-2.0 OR BSD-2-Clause)
%YAML 1.2
---
$id: http://devicetree.org/schemas/clock/sophgo,sg2042-sysclk.yaml#
$schema: http://devicetree.org/meta-schemas/core.yaml#

title: Sophgo SG2042 Clock Generator in System-Control

description:
  These clocks have configuration registers in the SYS_CTRL range of memory-map.
  So the node should be a child of system-control node.

maintainers:
  - Chen Wang <unicorn_wang@outlook.com>

properties:
  compatible:
    const: sophgo,sg2042-sysclk

  clocks:
    items:
      - description: Oscillator(Clock Generation IC) for Main/Fixed PLL (25 MHz)
      - description: Oscillator(Clock Generation IC) for DDR PLL 0 (25 MHz)
      - description: Oscillator(Clock Generation IC) for DDR PLL 1 (25 MHz)

  '#clock-cells':
    const: 1
    description:
      See <dt-bindings/clock/sophgo,sg2042-sysclk.h> for valid indices.

required:
  - compatible
  - clocks
  - '#clock-cells'

additionalProperties: false

examples:
  - |
    clock-controller {
      compatible = "sophgo,sg2042-sysclk";
      clocks = <&cgi_main>, <&cgi_dpll0>, <&cgi_dpll1>;
      #clock-cells = <1>;
    };
```

## Documentation/devicetree/bindings/clock/sophgo/sophgo,sg2042-clkgen.yaml
```yaml
# SPDX-License-Identifier: GPL-2.0-only OR BSD-2-Clause
%YAML 1.2
---
$id: http://devicetree.org/schemas/clock/sophgo/sophgo,sg2042-clkgen.yaml#
$schema: http://devicetree.org/meta-schemas/core.yaml#

title: Sophgo SG2042 Clock Generator

maintainers:
  - Chen Wang <unicorn_wang@outlook.com>

properties:
  compatible:
    const: sophgo,sg2042-clkgen

  clocks:
    items:
      - description: Clock Generation IC (25 MHz)

  '#clock-cells':
    const: 1
    description:
      See <dt-bindings/clock/sophgo-sg2042-clk.h> for valid indices.

  assigned-clocks: true

  assigned-clock-rates: true

required:
  - compatible
  - clocks
  - '#clock-cells'

additionalProperties: false

examples:
  - |
    clock-controller {
            compatible = "sophgo,sg2042-clkgen";
            clocks = <&cgi>;
            #clock-cells = <1>;
    };
```

## Documentation/devicetree/bindings/clock/spacemit,k1-ccu.yaml
```yaml
# SPDX-License-Identifier: GPL-2.0-only OR BSD-2-Clause
%YAML 1.2
---
$id: http://devicetree.org/schemas/clock/spacemit,k1-ccu.yaml#
$schema: http://devicetree.org/meta-schemas/core.yaml#

title: Spacemit K1 SoC Clock Controller

maintainers:
  - Haylen Chu <heylenay@outlook.com>

properties:
  compatible:
    enum:
      - spacemit,k1-ccu-apbs
      - spacemit,k1-ccu-mpmu
      - spacemit,k1-ccu-apbc
      - spacemit,k1-ccu-apmu

  clocks:
    minItems: 4
    maxItems: 4

  clock-names:
    items:
      - const: clk_32k
      - const: vctcxo_1
      - const: vctcxo_24
      - const: vctcxo_3

  spacemit,mpmu:
    $ref: /schemas/types.yaml#/definitions/phandle
    description:
      Phandle to the syscon managing "Main PMU (MPMU)" registers. It is used to
      check PLL lock status.

  "#clock-cells":
    const: 1
    description:
      See <dt-bindings/clock/spacemit,k1-ccu.h> for valid indices.

required:
  - compatible
  - "#clock-cells"

additionalProperties: false

allOf:
  - if:
      properties:
        compatible:
          contains:
            const: spacemit,k1-ccu-apbs
    then:
      required:
        - compatible
        - "#clock-cells"
        - spacemit,mpmu

examples:
  - |
    syscon_apbs: system-control@d4090000 {
        compatible = "spacemit,k1-apbs-syscon", "syscon", "simple-mfd";
        reg = <0x0 0xd4090000 0x0 0x1000>;

        clk_apbs: clock-controller {
            compatible = "spacemit,k1-ccu-apbs";
            #clock-cells = <1>;
            spacemit,mpmu = <&syscon_mpmu>;
        };
    };
```

## Documentation/devicetree/bindings/clock/thead,th1520-clk-ap.yaml
```yaml
# SPDX-License-Identifier: GPL-2.0-only OR BSD-2-Clause
%YAML 1.2
---
$id: http://devicetree.org/schemas/clock/thead,th1520-clk-ap.yaml#
$schema: http://devicetree.org/meta-schemas/core.yaml#

title: T-HEAD TH1520 AP sub-system clock controller

description: |
  The T-HEAD TH1520 AP sub-system clock controller configures the
  CPU, DPU, GMAC and TEE PLLs.

  SoC reference manual
  https://openbeagle.org/beaglev-ahead/beaglev-ahead/-/blob/main/docs/TH1520%20System%20User%20Manual.pdf

maintainers:
  - Jisheng Zhang <jszhang@kernel.org>
  - Wei Fu <wefu@redhat.com>
  - Drew Fustini <dfustini@tenstorrent.com>

properties:
  compatible:
    const: thead,th1520-clk-ap

  reg:
    maxItems: 1

  clocks:
    items:
      - description: main oscillator (24MHz)

  clock-names:
    items:
      - const: osc

  "#clock-cells":
    const: 1
    description:
      See <dt-bindings/clock/thead,th1520-clk-ap.h> for valid indices.

required:
  - compatible
  - reg
  - clocks
  - clock-names
  - "#clock-cells"

additionalProperties: false

examples:
  - |
    #include <dt-bindings/clock/thead,th1520-clk-ap.h>
    soc {

      #address-cells = <2>;
      #size-cells = <2>;

      clk: clock-controller@ffef010000 {
        compatible = "thead,th1520-clk-ap";
        reg = <0xff 0xef010000 0x0 0x1000>;
        clocks = <&osc>;
        clock-names = "osc";
        #clock-cells = <1>;
      };
    };
```

## Documentation/devicetree/bindings/dma/sophgo,cv1800-dmamux.yaml
```yaml
# SPDX-License-Identifier: (GPL-2.0-only OR BSD-2-Clause)
%YAML 1.2
---
$id: http://devicetree.org/schemas/dma/sophgo,cv1800-dmamux.yaml#
$schema: http://devicetree.org/meta-schemas/core.yaml#

title: Sophgo CV1800/SG200 Series DMA mux

maintainers:
  - Inochi Amaoto <inochiama@outlook.com>

allOf:
  - $ref: dma-router.yaml#

properties:
  compatible:
    const: sophgo,cv1800-dmamux

  reg:
    maxItems: 2

  '#dma-cells':
    const: 3
    description:
      The first cells is DMA channel. The second one is device id.
      The third one is the cpu id.

  dma-masters:
    maxItems: 1

  dma-requests:
    const: 8

required:
  - '#dma-cells'
  - dma-masters

additionalProperties: false

examples:
  - |
    dma-router {
      compatible = "sophgo,cv1800-dmamux";
      #dma-cells = <3>;
      dma-masters = <&dmac>;
      dma-requests = <8>;
    };
```

## Documentation/devicetree/bindings/iio/adc/sophgo,cv18xx-saradc.yaml
```yaml
# SPDX-License-Identifier: (GPL-2.0-only OR BSD-2-Clause)
%YAML 1.2
---
$id: http://devicetree.org/schemas/iio/adc/sophgo,cv18xx-saradc.yaml#
$schema: http://devicetree.org/meta-schemas/core.yaml#

title:
  Sophgo CV18XX SoC series 3 channels Successive Approximation Analog to
  Digital Converters

maintainers:
  - Thomas Bonnefille <thomas.bonnefille@bootlin.com>

description:
  Datasheet at https://github.com/sophgo/sophgo-doc/releases

properties:
  compatible:
    const: sophgo,cv1800b-saradc

  reg:
    maxItems: 1

  interrupts:
    maxItems: 1

  clocks:
    maxItems: 1

  '#address-cells':
    const: 1

  '#size-cells':
    const: 0

patternProperties:
  "^channel@[0-3]+$":
    $ref: adc.yaml

    description: |
      Represents the channels of the ADC.

    properties:
      reg:
        description: |
          The channel number. It can have up to 3 channels numbered from 0 to 2.
        items:
          - minimum: 0
            maximum: 2

    required:
      - reg

    additionalProperties: false


required:
  - compatible
  - reg
  - clocks

unevaluatedProperties: false

examples:
  - |
    #include <dt-bindings/clock/sophgo,cv1800.h>
    #include <dt-bindings/interrupt-controller/irq.h>
    adc@30f0000 {
        compatible = "sophgo,cv1800b-saradc";
        reg = <0x030f0000 0x1000>;
        clocks = <&clk CLK_SARADC>;
        interrupts = <100 IRQ_TYPE_LEVEL_HIGH>;
        #address-cells = <1>;
        #size-cells = <0>;

        channel@0 {
            reg = <0>;
        };
        channel@1 {
            reg = <1>;
        };
        channel@2 {
            reg = <2>;
        };
    };
```

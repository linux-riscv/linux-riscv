## Documentation/devicetree/bindings/net/can/cast,can.yaml
```yaml
# SPDX-License-Identifier: GPL-2.0-only OR BSD-2-Clause
%YAML 1.2
---
$id: http://devicetree.org/schemas/net/can/cast,can.yaml#
$schema: http://devicetree.org/meta-schemas/core.yaml#

title: CAST CAN controller

maintainers:
  - William Qiu <william.qiu@starfivetech.com>

allOf:
  - $ref: can-controller.yaml#
  - if:
      properties:
        compatible:
          contains:
            const: starfive,can
    then:
      required:
        - starfive,syscon

properties:
  compatible:
    enum:
      - cast,can
      - cast,canfd
      - starfive,can

  reg:
    maxItems: 1

  interrupts:
    maxItems: 1

  clocks:
    minItems: 3

  clock-names:
    items:
      - const: apb_clk
      - const: timer_clk
      - const: can_clk

  resets:
    minItems: 3

  reset-names:
    items:
      - const: rst_apb
      - const: rst_core
      - const: rst_timer

  starfive,syscon:
    $ref: /schemas/types.yaml#/definitions/phandle-array
    items:
      - items:
          - description: phandle to System Register Controller syscon node
          - description: offset of SYS_SYSCON_NE__SAIF__SYSCFG register for CAN controller
          - description: shift of SYS_SYSCON_NE__SAIF__SYSCFG register for CAN controller
          - description: mask of SYS_SYSCON_NE__SAIF__SYSCFG register for CAN controller
    description:
      Should be four parameters, the phandle to System Register Controller
      syscon node and the offset/shift/mask of SYS_SYSCON_NE__SAIF__SYSCFG register
      for CAN controller.

required:
  - compatible
  - reg
  - interrupts
  - clocks
  - clock-names
  - resets
  - reset-names

additionalProperties: false

examples:
  - |
    can@130d0000{
        compatible = "starfive,can";
        reg = <0x130d0000 0x1000>;
        interrupts = <112>;
        clocks = <&syscrg 115>,
                 <&syscrg 116>,
                 <&syscrg 117>;
        clock-names = "apb_clk", "timer_clk", "can_clk";
        resets = <&syscrg 111>,
                 <&syscrg 112>,
                 <&syscrg 113>;
        reset-names = "rst_apb", "rst_core", "rst_timer";
        starfive,syscon = <&sys_syscon 0x10 0x3 0x8>;
    };

...
```

## Documentation/devicetree/bindings/nvmem/sophgo,efuse.yaml
```yaml
# SPDX-License-Identifier: GPL-2.0-only OR BSD-2-Clause
%YAML 1.2
---
$id: http://devicetree.org/schemas/nvmem/sophgo,efuse.yaml#
$schema: http://devicetree.org/meta-schemas/core.yaml#

title: Sophgo SoC eFuse-based NVMEM

description: |
  Sophgo SoCs such as the CV1800B contain factory-programmed eFuses used to e.g. store
  calibration data for the built-in ethernet PHY.
maintainers:
  - Jisheng Zhang <jszhang@kernel.org>

allOf:
  - $ref: nvmem.yaml#
  - $ref: nvmem-deprecated-cells.yaml#

properties:
  compatible:
    items:
      - enum:
          - sophgo,cv1800b-efuse

  reg:
    maxItems: 1

  clocks:
    description:
      eFuse clock id.
    maxItems: 1

required:
  - compatible
  - reg
  - clocks

unevaluatedProperties: false

examples:
  - |
    efuse@3050000 {
        compatible = "sophgo,cv1800b-efuse";
        reg = <0x3050000 0x1000>;
        #address-cells = <1>;
        #size-cells = <1>;
        clocks = <&clk 1>;

        ephy_txitune: ephy-txitune@24 {
            reg = <0x24 0x4>;
        };
    };

...
```

## Documentation/devicetree/bindings/phy/sophgo,cv1800-usb-phy.yaml
```yaml
# SPDX-License-Identifier: (GPL-2.0 OR BSD-2-Clause)
# Copyright 2019 BayLibre, SAS
%YAML 1.2
---
$id: http://devicetree.org/schemas/phy/sophgo,cv1800-usb-phy.yaml#
$schema: http://devicetree.org/meta-schemas/core.yaml#

title: Sophgo CV1800 USB PHY

maintainers:
  - Yao Zi <ziyao@disroot.org>

properties:
  compatible:
    enum:
      - sophgo,cv1800-usb-phy

  reg:
    maxItems: 2

  reg-names:
    items:
      - const: phy
      - const: pin

  clocks:
    maxItems: 4

  clock-names:
    items:
      - const: apb
      - const: 125m
      - const: 33k
      - const: 12m

  "#phy-cells":
    const: 0

  dr_role:
    enum:
      - host
      - device

required:
  - compatible
  - reg
  - reg-names
  - clocks
  - clock-names
  - "#phy-cells"

additionalProperties: false

examples:
  - |
    #include <dt-bindings/clock/sophgo,cv1800.h>
    usb_phy: usb-phy@3006000 {
        compatible = "sophgo,cv1800-usb-phy";
        reg = <0x300600 0x60>, <0x3000048 0x4>;
        reg-names = "phy", "pin";
        clocks = <&clk CLK_APB_USB>,
                 <&clk CLK_USB_125M>,
                 <&clk CLK_USB_33K>,
                 <&clk CLK_USB_12M>;
        clock-names = "apb", "125m", "33k", "12m";
        #phy-cells = <0>;
    };
```

## Documentation/devicetree/bindings/pinctrl/sophgo,cv1800-pinctrl.yaml
```yaml
# SPDX-License-Identifier: GPL-2.0-only OR BSD-2-Clause
%YAML 1.2
---
$id: http://devicetree.org/schemas/pinctrl/sophgo,cv1800-pinctrl.yaml#
$schema: http://devicetree.org/meta-schemas/core.yaml#

title: Sophgo CV1800 Pin Controller

maintainers:
  - Inochi Amaoto <inochiama@outlook.com>

properties:
  compatible:
    enum:
      - sophgo,cv1800b-pinctrl
      - sophgo,cv1812h-pinctrl
      - sophgo,sg2000-pinctrl
      - sophgo,sg2002-pinctrl

  reg:
    items:
      - description: pinctrl for system domain
      - description: pinctrl for rtc domain

  reg-names:
    items:
      - const: sys
      - const: rtc

  resets:
    maxItems: 1

patternProperties:
  '-cfg$':
    type: object
    patternProperties:
      '-pins$':
        type: object
        description: |
          A pinctrl node should contain at least one subnode representing the
          pinctrl groups available on the machine. Each subnode will list the
          pins it needs, and how they should be configured, with regard to
          muxer configuration, bias, input enable/disable, input schmitt
          trigger enable/disable, slew-rate and drive strength.
        $ref: /schemas/pinctrl/pincfg-node.yaml

        properties:
          pinmux:
            description: |
              The list of GPIOs and their mux settings that properties in the
              node apply to. This should be set using the GPIOMUX or GPIOMUX2
              macro.
            $ref: /schemas/pinctrl/pinmux-node.yaml#/properties/pinmux

          bias-pull-up:
            type: boolean

          bias-pull-down:
            type: boolean

          drive-strength:
            $ref: /schemas/types.yaml#/definitions/uint32
            minimum: 0
            maximum: 7

          input-schmitt:
            $ref: /schemas/types.yaml#/definitions/uint32
            minimum: 0
            maximum: 7

          slew-rate:
            enum: [ 0, 1 ]

          sophgo,bus-holder:
            description: enable bus holder
            type: boolean

        additionalProperties: false

    additionalProperties: false

required:
  - compatible
  - reg
  - reg-names

additionalProperties: false

examples:
  - |
    #include <dt-bindings/pinctrl/pinctrl-cv1800b.h>

    soc {
        #address-cells = <1>;
        #size-cells = <1>;

        pinctrl@3001000 {
            compatible = "sophgo,cv1800b-pinctrl";
            reg = <0x03001000 0x1000>,
                  <0x05027000 0x1000>;
            reg-names = "sys", "rtc";

            uart0_cfg: uart0-cfg {
                uart0-pins {
                    pinmux = <PINMUX(PIN_UART0_TX, 0)>,
                             <PINMUX(PIN_UART0_RX, 0)>;
                    bias-pull-up;
                    drive-strength = <2>;
                    slew-rate = <0>;
                };
            };
        };

        uart0 {
            pinctrl-0 = <&uart0_cfg>;
            pinctrl-names = "default";
        };
    };

...
```

## Documentation/devicetree/bindings/soc/sophgo/sophgo,cv1800-top-syscon.yaml
```yaml
# SPDX-License-Identifier: (GPL-2.0 OR BSD-2-Clause)
%YAML 1.2
---
$id: http://devicetree.org/schemas/soc/sophgo/sophgo,cv1800-top-syscon.yaml#
$schema: http://devicetree.org/meta-schemas/core.yaml#

title: Sophgo CV1800/SG2000 SoC top system controller

maintainers:
  - Inochi Amaoto <inochiama@outlook.com>

description:
  The Sophgo CV1800/SG2000 SoC top misc system controller provides
  register access to configure related modules.

properties:
  compatible:
    items:
      - const: sophgo,cv1800-top-syscon
      - const: syscon
      - const: simple-mfd

  reg:
    maxItems: 1

  "#address-cells":
    const: 1

  "#size-cells":
    const: 1

required:
  - compatible
  - reg

additionalProperties:
  type: object

examples:
  - |
    syscon@3000000 {
      compatible = "sophgo,cv1800-top-syscon",
                   "syscon", "simple-mfd";
      reg = <0x03000000 0x1000>;
      #address-cells = <1>;
      #size-cells = <1>;

      dma-router@154 {
        compatible = "sophgo,cv1800-dmamux";
        reg = <0x154 0x8>, <0x298 0x4>;
        #dma-cells = <3>;
        dma-masters = <&dmac>;
        dma-requests = <8>;
      };
    };

...
```

## Documentation/devicetree/bindings/soc/sophgo/sophgo,sg2042-syscon.yaml
```yaml
# SPDX-License-Identifier: (GPL-2.0 OR BSD-2-Clause)
%YAML 1.2
---
$id: http://devicetree.org/schemas/soc/sophgo/sophgo,sg2042-syscon.yaml#
$schema: http://devicetree.org/meta-schemas/core.yaml#

title: Sophgo SG2042 SoC system controller

maintainers:
  - Chen Wang <unicorn_wang@outlook.com>

description:
  The Sophgo SG2042 SoC system controller provides register information such
  as offset, mask and shift to configure some modules, such as clocks, reset
  signals and pinctrl.

properties:
  compatible:
    items:
      - enum:
          - sophgo,sg2042-syscon
      - const: syscon

  reg:
    maxItems: 1

  clock-controller:
    # Child node
    type: object
    $ref: ../../clock/sophgo/sophgo,sg2042-clkgen.yaml
    description:
      Clock controller for the SoC clocks. This child node definition
      should follow the bindings specified in
      Documentation/devicetree/bindings/clock/sophgo/sophgo,sg2042-clkgen.yaml

required:
  - compatible
  - reg

additionalProperties: false

examples:
  - |
    syscon@30010000 {
        compatible = "sophgo,sg2042-syscon", "syscon";
        reg = <0x30010000 0x1000>;
    };

    syscon@30020000 {
        compatible = "sophgo,sg2042-syscon", "syscon";
        reg = <0x30020000 0x1000>;

        clock-controller {
            compatible = "sophgo,sg2042-clkgen";
            clocks = <&osc>;
            #clock-cells = <1>;
        };
    };
```

## Documentation/devicetree/bindings/soc/sophgo/sophgo,sg2042-sysctrl.yaml
```yaml
# SPDX-License-Identifier: (GPL-2.0 OR BSD-2-Clause)
%YAML 1.2
---
$id: http://devicetree.org/schemas/soc/sophgo/sophgo,sg2042-sysctrl.yaml#
$schema: http://devicetree.org/meta-schemas/core.yaml#

title: Sophgo SG2042 SoC system control

maintainers:
  - Chen Wang <unicorn_wang@outlook.com>

description:
  The Sophgo system control is a registers block (SYS_CTRL), providing multiple
  low level platform functions like chip configuration, clock control, etc.

properties:
  compatible:
    const: sophgo,sg2042-sysctrl

  reg:
    maxItems: 1

  clock-controller:
    # Child node
    $ref: /schemas/clock/sophgo,sg2042-sysclk.yaml#
    type: object

required:
  - compatible
  - reg
  - clock-controller

additionalProperties: false

examples:
  - |
    system-control@30010000 {
        compatible = "sophgo,sg2042-sysctrl";
        reg = <0x30010000 0x1000>;

        clock-controller {
          compatible = "sophgo,sg2042-sysclk";
          clocks = <&cgi_main>, <&cgi_dpll0>, <&cgi_dpll1>;
          #clock-cells = <1>;
        };
    };
```

## Documentation/devicetree/bindings/soc/spacemit/spacemit,k1-syscon.yaml
```yaml
# SPDX-License-Identifier: (GPL-2.0-only OR BSD-2-Clause)
%YAML 1.2
---
$id: http://devicetree.org/schemas/soc/spacemit/spacemit,k1-syscon.yaml#
$schema: http://devicetree.org/meta-schemas/core.yaml#

title: Spacemit K1 SoC System Controller

maintainers:
  - Haylen Chu <heylenay@outlook.com>

description:
  The Spacemit K1 SoC system controller provides access to shared register files
  for related SoC modules, such as clock controller and reset controller.

properties:
  compatible:
    items:
      - enum:
          - spacemit,k1-apbc-syscon
          - spacemit,k1-apbs-syscon
          - spacemit,k1-apmu-syscon
          - spacemit,k1-mpmu-syscon
      - const: syscon
      - const: simple-mfd

  reg:
    maxItems: 1

  clock-controller:
    $ref: /schemas/clock/spacemit,k1-ccu.yaml#
    type: object

  "#address-cells":
    const: 1

  "#size-cells":
    const: 1

additionalProperties: false

required:
  - compatible
  - reg

examples:
  - |
    syscon_mpmu: system-controller@d4050000 {
        compatible = "spacemit,mpmu-syscon", "syscon", "simple-mfd";
        reg = <0xd4050000 0x209c>;
    };
```

## Documentation/devicetree/bindings/thermal/sophgo,cv1800-thermal.yaml
```yaml
# SPDX-License-Identifier: (GPL-2.0 OR BSD-2-Clause)
%YAML 1.2
---
$id: http://devicetree.org/schemas/thermal/sophgo,cv1800-thermal.yaml#
$schema: http://devicetree.org/meta-schemas/core.yaml#

title: Sophgo CV1800 on-SoC Thermal Sensor

maintainers:
  - Haylen Chu <heylenay@outlook.com>

description: Binding for Sophgo CV1800 on-SoC thermal sensor

properties:
  compatible:
    enum:
      - sophgo,cv1800-thermal

  reg:
    maxItems: 1

  clocks:
    description: The thermal sensor clock

  interrupts:
    maxItems: 1

  accumulation-period:
    $ref: /schemas/types.yaml#/definitions/uint32
    description: Accumulation period for a sample
    enum:
      - 512
      - 1024
      - 2048
      - 4096
    default: 2048

  chop-period:
    $ref: /schemas/types.yaml#/definitions/uint32
    description: ADC chop period
    enum:
      - 128
      - 256
      - 512
      - 1024
    default: 1024

  sample-cycle-us:
    description: Period between samples. Should be greater than 524us.
    default: 1000000

  '#thermal-sensor-cells':
    const: 0

required:
  - compatible
  - reg
  - clocks
  - interrupts

additionalProperties: false

examples:
  - |
        #include <dt-bindings/clock/sophgo,cv1800.h>
        #include <dt-bindings/interrupt-controller/irq.h>
        thermal-sensor@30e0000 {
            compatible = "sophgo,cv1800-thermal";
            reg = <0x30e0000 0x100>;
            clocks = <&clk CLK_TEMPSEN>;
            interrupts = <16 IRQ_TYPE_LEVEL_HIGH>;
            #thermal-sensor-cells = <0>;
        };
...
```
